## zerotier-plus/Config.in
```kconfig
menu "Configuration"
	depends on PACKAGE_zerotier-plus

config ZEROTIER_PLUS_ENABLE_DEBUG
	bool "Build in debug mode"
	depends on PACKAGE_zerotier-plus
	default n

config ZEROTIER_PLUS_ENABLE_SELFTEST
	bool "Build a self test program"
	depends on PACKAGE_zerotier-plus
	default n

endmenu
```

## zerotier/Config.in
```kconfig
menu "Configuration"
	depends on PACKAGE_zerotier-plus

config ZEROTIER_ENABLE_DEBUG
	bool "Build in debug mode"
	depends on PACKAGE_zerotier-plus
	default n

config ZEROTIER_ENABLE_SELFTEST
	bool "Build a self test program"
	depends on PACKAGE_zerotier-plus
	default n

endmenu
```
